#include <SPI.h>
#include <Wire.h>
#include <Adafruit_GFX.h>
#include <Adafruit_SSD1306.h>

//#include <Fonts/FreeSansBold9pt7b.h>
#define OLED_RESET 4
Adafruit_SSD1306 display(OLED_RESET);

#define NUMFLAKES 10

#define XPOS 0

#define YPOS 1

#define DELTAY 2

#define LOGO16_GLCD_HEIGHT 16

#define LOGO16_GLCD_WIDTH 16
// draw pattern here 

// This is a bitmap image for call (when you receive a call)
static const unsigned char PROGMEM Call[] = //128x64 bitmap
{0x00, 0x00, 0x00, 0x00, 0x00, 0x00, 0x00, 0x00, 0x00, 0x00, 0x00, 0x00, 0x00, 0x00, 0x00, 0x00,
0x00, 0x00, 0x00, 0x00, 0x00, 0x00, 0x00, 0x00, 0x00, 0x00, 0x00, 0x00, 0x00, 0x00, 0x00, 0x00,
0x00, 0x00, 0x00, 0x00, 0x00, 0x00, 0x00, 0x00, 0x00, 0x00, 0x00, 0x00, 0x00, 0x00, 0x00, 0x00,
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0x00, 0x00, 0x00, 0x00, 0x00, 0x00, 0x00, 0x00, 0x00, 0x00, 0x00, 0x00, 0x00, 0x00, 0x00, 0x00
  };


// This is a bitmap image for SMS (when you receive a SMS)
static const unsigned char PROGMEM SMS[] = //128x64 bitmap
{0x00, 0x00, 0x00, 0x00, 0x00, 0x00, 0x00, 0x00, 0x00, 0x00, 0x00, 0x00, 0x00, 0x00, 0x00, 0x00,
0x00, 0x00, 0x00, 0x00, 0x00, 0x00, 0x00, 0x00, 0x00, 0x00, 0x00, 0x00, 0x00, 0x00, 0x00, 0x00,
0x00, 0x00, 0x00, 0x00, 0x00, 0x00, 0x00, 0x00, 0x00, 0x00, 0x00, 0x00, 0x00, 0x00, 0x00, 0x00,
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0x00, 0x00, 0x00, 0x00, 0x00, 0x00, 0x00, 0x00, 0x00, 0x00, 0x00, 0x00, 0x00, 0x00, 0x00, 0x00

  };

// This is a bitmap image for Main (when you receive Mail)
static const unsigned char PROGMEM Mail[] = //128x64 bitmap
{0x00, 0x00, 0x00, 0x00, 0x00, 0x00, 0x00, 0x00, 0x00, 0x00, 0x00, 0x00, 0x00, 0x00, 0x00, 0x00,
0x00, 0x00, 0x00, 0x00, 0x00, 0x00, 0x00, 0x00, 0x00, 0x00, 0x00, 0x00, 0x00, 0x00, 0x00, 0x00,
0x00, 0x00, 0x00, 0x00, 0x00, 0x00, 0x00, 0x00, 0x00, 0x00, 0x00, 0x00, 0x00, 0x00, 0x00, 0x00,
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0x00, 0x00, 0x00, 0x00, 0x00, 0x00, 0x00, 0x00, 0x00, 0x00, 0x00, 0x00, 0x00, 0x00, 0x00, 0x00

  };

// This is a bitmap image for Navigation (when you receive an Navigation notification)
static const unsigned char PROGMEM Navi[] = //128x64 bitmap
{ 0x00, 0x00, 0x00, 0x00, 0x00, 0x00, 0x00, 0x00, 0x00, 0x00, 0x00, 0x00, 0x00, 0x00, 0x00, 0x00,
0x00, 0x00, 0x00, 0x00, 0x00, 0x00, 0x00, 0x00, 0x00, 0x00, 0x00, 0x00, 0x00, 0x00, 0x00, 0x00,
0x00, 0x00, 0x00, 0x00, 0x00, 0x00, 0x00, 0x00, 0x00, 0x00, 0x00, 0x00, 0x00, 0x00, 0x00, 0x00,
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0x00, 0x00, 0x00, 0x00, 0x00, 0x00, 0x00, 0x00, 0x00, 0x00, 0x00, 0x00, 0x00, 0x00, 0x00, 0x00

};

// This is a bitmap image for WhatsApp (when you receive an whats app notification)
static const unsigned char PROGMEM Whatsapp[] = //128x64 bitmap
{ 0x00, 0x00, 0x00, 0x00, 0x00, 0x00, 0x00, 0x00, 0x00, 0x00, 0x00, 0x00, 0x00, 0x00, 0x00, 0x00,
0x00, 0x00, 0x00, 0x00, 0x00, 0x00, 0x00, 0x00, 0x00, 0x00, 0x00, 0x00, 0x00, 0x00, 0x00, 0x00,
0x00, 0x00, 0x00, 0x00, 0x00, 0x00, 0x00, 0x00, 0x00, 0x00, 0x00, 0x00, 0x00, 0x00, 0x00, 0x00,
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0x00, 0x00, 0x00, 0x00, 0x3C, 0x00, 0x00, 0x00, 0x00, 0x00, 0x00, 0x00, 0x00, 0x00, 0x00, 0x00
};

#if (SSD1306_LCDHEIGHT != 64)

#error("Height incorrect, please fix Adafruit_SSD1306.h!");
#endif

void setup() {
Serial.begin(9600);

Serial.setTimeout(4);
display.begin(SSD1306_SWITCHCAPVCC, 0x3C); // initialize with the I2C addr 0x3D (for the 128x64) // init done // Show image buffer on the display hardware.
//display.setFont(&FreeSansBold9pt7b);


display.display(); //delay(2000);

display.setTextSize(1);
display.setTextColor(WHITE);
display.setCursor(0, 13);

  delay(1000);
display.clearDisplay();

testdrawtriangle();
  display.display();
  delay(500);
  display.clearDisplay();
//display.drawBitmap(10, -5,  Call, 128, 64, 2);
//        display.display();
//        delay(500);
//  display.clearDisplay();
//      display.drawBitmap(10, -5,  SMS, 128, 64, 2);
//        display.display();
//        delay(500);
//  display.clearDisplay();
//      display.drawBitmap(0, -5,  Mail, 128, 64, 1);
//        display.display();
//        delay(500);
//  display.clearDisplay();
//        display.drawBitmap(0, -5,  Navi, 128, 64, 1);
//        display.display();
//        delay(500);
//  display.clearDisplay();
//display.drawBitmap(0, -5,  Whatsapp, 128, 64, 1);
//        display.display();
//        delay(500);
//display.clearDisplay();

//display.startscrollright(0x00, 0x0F)  ;
//display.dim(1);
display.println("   E.l.E.v.E.n.");

// invert the display

display.display();

display.clearDisplay(); }

void loop() {
  digitalWrite(LED_BUILTIN, HIGH);   // turn the LED on (HIGH is the voltage level)
while (1) {

display.setTextSize(1);

display.setTextColor(INVERSE);

display.setCursor(0, -10);

display.clearDisplay();

display.println("");

printText();

display.display();

}

}

void printText(void) {

String s;

if (Serial.available()) {

s = Serial.readString(); //getting string input in variable "s"

if (s.substring(0,8) == "Messages") {
display.drawBitmap(10, -5,  SMS, 128, 64, 1);
 display.display();
  delay(1000);
  display.clearDisplay();
}
if (s.substring(0,8) == "WhatsApp") {
display.drawBitmap(10, -5,  Whatsapp, 128, 64, 1);
 display.display();
  delay(1000);
  display.clearDisplay();
}

if (s.substring(0,10) == "MapmyIndia") {
display.drawBitmap(10, -5,  Navi, 128, 64, 1);
 display.display();
  delay(1000);
  display.clearDisplay();
}

if (s.substring(0,13) == "Incoming Call") {
display.drawBitmap(10, -5,  Call, 128, 64, 1);
 display.display();
  delay(1000);
  display.clearDisplay();
}

if (s.substring(0,5) == "Gmail") {
display.drawBitmap(10, -5,  Mail, 128, 64, 1);
 display.display();
  delay(1000);
  display.clearDisplay();
}


display.println(s);

display.display();

display.println("\n");

}

delay(7000);

}

void testdrawtriangle(void) {
  for (int16_t i=0; i<min(display.width(),display.height())/3; i+=1) {
    display.drawTriangle(display.width()/2, display.height()/2-i,
                     display.width()/2-i, display.height()/2+i,
                     display.width()/2+i, display.height()/2+i, WHITE);
    display.display();
    delay(1);
  }
}

